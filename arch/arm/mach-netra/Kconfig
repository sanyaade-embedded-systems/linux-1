## arch/arm/mach-netra/Kconfig
```kconfig
comment "Netra Board Type"
	depends on ARCH_NETRA

config MACH_NETRA_SIM
	bool "Netra Simulator"
	depends on ARCH_NETRA
	select CPU_CORTEXA8
	select CPU_V7
```

## arch/arm/mach-omap2/Kconfig
```kconfig
comment "OMAP Core Type"
	depends on ARCH_OMAP2

config ARCH_OMAP24XX
	bool "OMAP24xx Based System"
	depends on ARCH_OMAP2

config ARCH_OMAP2420
	bool "OMAP2420 support"
	depends on ARCH_OMAP24XX
	select OMAP_DM_TIMER
	select ARCH_OMAP_OTG

config ARCH_OMAP2430
	bool "OMAP2430 support"
	depends on ARCH_OMAP24XX

config ARCH_OMAP34XX
	bool "OMAP34xx Based System"
	depends on ARCH_OMAP3

config ARCH_OMAP3430
	bool "OMAP3430 support"
	depends on ARCH_OMAP3 && ARCH_OMAP34XX
	select ARCH_OMAP_OTG

comment "OMAP Board Type"
	depends on ARCH_OMAP2 || ARCH_OMAP3 || ARCH_OMAP4

config MACH_OMAP_GENERIC
	bool "Generic OMAP board"
	depends on ARCH_OMAP2 && ARCH_OMAP24XX

config MACH_OMAP_H4
	bool "OMAP 2420 H4 board"
	depends on ARCH_OMAP2 && ARCH_OMAP24XX
	select OMAP_DEBUG_DEVICES

config MACH_OMAP_APOLLON
	bool "OMAP 2420 Apollon board"
	depends on ARCH_OMAP2 && ARCH_OMAP24XX

config MACH_OMAP_2430SDP
	bool "OMAP 2430 SDP board"
	depends on ARCH_OMAP2 && ARCH_OMAP24XX

config MACH_OMAP3_BEAGLE
	bool "OMAP3 BEAGLE board"
	depends on ARCH_OMAP3 && ARCH_OMAP34XX

config MACH_OMAP_LDP
	bool "OMAP3 LDP board"
	depends on ARCH_OMAP3 && ARCH_OMAP34XX

config MACH_OVERO
	bool "Gumstix Overo board"
	depends on ARCH_OMAP3 && ARCH_OMAP34XX

config MACH_OMAP3EVM
	bool "OMAP 3530 EVM board"
	depends on ARCH_OMAP3 && ARCH_OMAP34XX

config WIFI_CONTROL_FUNC
        bool "Enable WiFi control function abstraction"
	depends on MACH_OMAP_4430SDP
	default Y
        help
          Enables Power/Reset/Carddetect function abstraction
config TIWLAN_SDIO
	bool "TI WLAN Enhanced SDIO Contoller support"
	depends on MMC_OMAP || MMC_OMAP_MODULE || MMC_OMAP_HS || MMC_OMAP_HS_MODULE
	help
	   Say Y here if you want to be able to use TI's WLAN device using the
	   SDIO interface. If unsure, say N.
config TIWLAN_MMC_CONTROLLER
	int "MMC Controller number that TI WLAN chip is connected to"
	range 1 5
	depends on TIWLAN_SDIO || MMC_EMBEDDED_SDIO
	default "5"
	help
	  Choose the number of the MMC controller that TI WLAN chip is
	  connected to. TI WLAN has SDIO host controller that will control
	  this MMC port.

config MACH_OMAP3_PANDORA
	bool "OMAP3 Pandora"
	depends on ARCH_OMAP3 && ARCH_OMAP34XX

config MACH_OMAP_3430SDP
	bool "OMAP 3430 SDP board"
	depends on ARCH_OMAP3 && ARCH_OMAP34XX

config MACH_NOKIA_RX51
	bool "Nokia RX-51 board"
	depends on ARCH_OMAP3 && ARCH_OMAP34XX

config MACH_OMAP_ZOOM2
	bool "OMAP3 Zoom2 board"
	depends on ARCH_OMAP3 && ARCH_OMAP34XX

config MACH_OMAP_4430SDP
	bool "OMAP 4430 SDP board"
	depends on ARCH_OMAP4
```

## drivers/i2c/chips/Kconfig
```kconfig
#
# Miscellaneous I2C chip drivers configuration
#
# *** DEPRECATED! Do not add new entries! See Makefile ***
#

menu "Miscellaneous I2C Chip support"

config DS1682
	tristate "Dallas DS1682 Total Elapsed Time Recorder with Alarm"
	depends on EXPERIMENTAL
	help
	  If you say yes here you get support for Dallas Semiconductor
	  DS1682 Total Elapsed Time Recorder.

	  This driver can also be built as a module.  If so, the module
	  will be called ds1682.

config SENSORS_PCF8574
	tristate "Philips PCF8574 and PCF8574A (DEPRECATED)"
	depends on EXPERIMENTAL && GPIO_PCF857X = "n"
	default n
	help
	  If you say yes here you get support for Philips PCF8574 and 
	  PCF8574A chips. These chips are 8-bit I/O expanders for the I2C bus.

	  This driver can also be built as a module.  If so, the module
	  will be called pcf8574.

	  This driver is deprecated and will be dropped soon. Use
	  drivers/gpio/pcf857x.c instead.

	  These devices are hard to detect and rarely found on mainstream
	  hardware.  If unsure, say N.

config PCF8575
	tristate "Philips PCF8575 (DEPRECATED)"
	default n
	depends on GPIO_PCF857X = "n"
	help
	  If you say yes here you get support for Philips PCF8575 chip.
	  This chip is a 16-bit I/O expander for the I2C bus.  Several other
	  chip manufacturers sell equivalent chips, e.g. Texas Instruments.

	  This driver can also be built as a module.  If so, the module
	  will be called pcf8575.

	  This driver is deprecated and will be dropped soon. Use
	  drivers/gpio/pcf857x.c instead.

	  This device is hard to detect and is rarely found on mainstream
	  hardware.  If unsure, say N.

config SENSORS_PCA9539
	tristate "Philips PCA9539 16-bit I/O port (DEPRECATED)"
	depends on EXPERIMENTAL && GPIO_PCA953X = "n"
	help
	  If you say yes here you get support for the Philips PCA9539
	  16-bit I/O port.

	  This driver can also be built as a module.  If so, the module
	  will be called pca9539.

	  This driver is deprecated and will be dropped soon. Use
	  drivers/gpio/pca953x.c instead.

config SENSORS_TSL2550
	tristate "Taos TSL2550 ambient light sensor"
	depends on EXPERIMENTAL
	help
	  If you say yes here you get support for the Taos TSL2550
	  ambient light sensor.

	  This driver can also be built as a module.  If so, the module
	  will be called tsl2550.

config TWL4030_MADC
	tristate "TWL4030 MADC Driver"
	depends on TWL4030_CORE
	help
	The TWL4030 Monitoring ADC driver enables the host
	processor to monitor analog signals using analog-to-digital
	conversions on the input source. TWL4030 MADC provides the
	following features:
	 - Single 10-bit ADC with successive approximation register (SAR) conversion;
	 - Analog multiplexer for 16 inputs;
	 - Seven (of the 16) inputs are freely available;
	 - Battery voltage monitoring;
	 - Concurrent conversion request management;
	 - Interrupt signal to Primary Interrupt Handler;
	 - Averaging feature;
	 - Selective enable/disable of the averaging feature.

	Say 'y' here to statically link this module into the kernel or 'm'
	to build it as a dinamically loadable module. The module will be
	called twl4030-madc.ko

endmenu
```

## drivers/media/video/tiler/Kconfig
```kconfig
menuconfig dmm_tiler
	bool "dmm_tiler"
	default y

if dmm_tiler

config DMM_TILER
        tristate "dmm_tiler"
        default m
        help
           dmm tiler driver
endif
```

## drivers/video/omap/Kconfig
```kconfig
config FB_OMAP
	tristate "OMAP frame buffer support (EXPERIMENTAL)"
	depends on FB && ARCH_OMAP
	select FB_CFB_FILLRECT
	select FB_CFB_COPYAREA
	select FB_CFB_IMAGEBLIT
	help
          Frame buffer driver for OMAP based boards.

config FB_OMAP_VIDEO_MODE
	string "Default video mode"
	depends on FB_OMAP
	help
	  Enter video mode name to use if none is specified on the kernel
	  command line. If left blank, board-specific default timings
	  will be used. See omapfb_main.c for a list of valid mode names.

config FB_OMAP_LCDC_EXTERNAL
	bool "External LCD controller support"
	depends on FB_OMAP
	help
	  Say Y here, if you want to have support for boards with an
	  external LCD controller connected to the SoSSI/RFBI interface.

config FB_OMAP_LCDC_HWA742
	bool "Epson HWA742 LCD controller support"
	depends on FB_OMAP && FB_OMAP_LCDC_EXTERNAL
	help
	  Say Y here if you want to have support for the external
	  Epson HWA742 LCD controller.

config FB_OMAP_LCDC_BLIZZARD
	bool "Epson Blizzard LCD controller support"
	depends on FB_OMAP && FB_OMAP_LCDC_EXTERNAL
	help
	  Say Y here if you want to have support for the external
	  Epson Blizzard LCD controller.

config FB_OMAP_MANUAL_UPDATE
	bool "Default to manual update mode"
	depends on FB_OMAP && FB_OMAP_LCDC_EXTERNAL
	help
	  Say Y here, if your user-space applications are capable of
	  notifying the frame buffer driver when a change has occured in
          the frame buffer content and thus a reload of the image data to
	  the external frame buffer is required. If unsure, say N.

config FB_OMAP_LCD_MIPID
	bool "MIPI DBI-C/DCS compatible LCD support"
	depends on FB_OMAP && SPI_MASTER && CBUS_TAHVO
	help
	  Say Y here if you want to have support for LCDs compatible with
	  the Mobile Industry Processor Interface DBI-C/DCS
	  specification. (Supported LCDs: Philips LPH8923, Sharp LS041Y3)

config OMAP_FB_LCD_AMS_DELTA
	tristate "AMS DELTA LCD support"
	depends on FB_OMAP && MACH_AMS_DELTA

config OMAP_FB_LCD_H2
	tristate "H2 LCD support"
	depends on FB_OMAP && MACH_OMAP_H2

config OMAP_FB_LCD_H3
	tristate "H3 LCD support"
	depends on FB_OMAP && MACH_OMAP_H3

config OMAP_FB_LCD_H4
	tristate "OMAP 2420 H4 LCD support"
	depends on FB_OMAP && MACH_OMAP_H4

config OMAP_FB_LCD_PALMTE
	tristate "PALMTE LCD support"
	depends on FB_OMAP && MACH_OMAP_PALMTE

config OMAP_FB_LCD_PALMTT
	tristate "PALMTT LCD support"
	depends on FB_OMAP && MACH_OMAP_PALMTT

config OMAP_FB_LCD_PALMZ71
	tristate "PALMZ71 LCD support"
	depends on FB_OMAP && MACH_OMAP_PALMZ71

config OMAP_FB_LCD_INN1610
	tristate "INN1610 LCD support"
	depends on FB_OMAP && ARCH_OMAP16XX && MACH_OMAP_INNOVATOR

config OMAP_FB_LCD_INN1510
	tristate "INN1510 LCD support"
	depends on FB_OMAP && ARCH_OMAP15XX && MACH_OMAP_INNOVATOR

config OMAP_FB_LCD_OSK
	tristate "OSK LCD support"
	depends on FB_OMAP && MACH_OMAP_OSK

config OMAP_FB_LCD_SX1
	tristate "SX1 LCD support"
	depends on FB_OMAP && MACH_SX1

config OMAP_FB_LCD_APOLLON
	tristate "OMAP 2420 Apollon LCD support"
	depends on FB_OMAP && MACH_OMAP_APOLLON

config OMAP_FB_LCD_2430SDP
	tristate "OMAP 2430/3430 SDP LCD support"
	depends on FB_OMAP && (MACH_OMAP_2430SDP || MACH_OMAP_3430SDP)

config OMAP_FB_LCD_OMAP2EVM
	tristate "OMAP 2530 EVM LCD support"
	depends on FB_OMAP && MACH_OMAP2EVM

config OMAP_FB_LCD_OMAP3EVM
	tristate "OMAP 3530 EVM LCD support"
	depends on FB_OMAP && MACH_OMAP3EVM

config OMAP_FB_LCD_OMAP3BEAGLE
	tristate "Beagle board DVI port support"
	depends on FB_OMAP && MACH_OMAP3_BEAGLE

config FB_OMAP_BOOTLOADER_INIT
	bool "Check bootloader initialization"
	depends on FB_OMAP
	help
	  Say Y here if you want to enable checking if the bootloader has
	  already initialized the display controller. In this case the
	  driver will skip the initialization.

config FB_OMAP_CONSISTENT_DMA_SIZE
	int "Consistent DMA memory size (MB)"
	depends on FB_OMAP
	range 1 14
	default 2
	help
	  Increase the DMA consistent memory size according to your video
	  memory needs, for example if you want to use multiple planes.
	  The size must be 2MB aligned.
	  If unsure say 1.

config FB_OMAP_DMA_TUNE
        bool "Set DMA SDRAM access priority high"
        depends on FB_OMAP && ARCH_OMAP1
        help
          On systems in which video memory is in system memory
          (SDRAM) this will speed up graphics DMA operations.
          If you have such a system and want to use rotation
          answer yes. Answer no if you have a dedicated video
          memory, or don't use any of the accelerated features.
```

## fs/simfs/Kconfig
```kconfig
config  SIMFS
	bool "Local filesystem support"
	default y
	help
	  Choose Y here if you want to access files residing on your PC
          drives. This is supported only on TI netra simulator M5.1
          release onwards.

	  If unsure, say Y.

	  Most people say Y here.

config  SIMFS_PHYSADDR
	hex
	default 0x40280000
	depends on SIMFS
```
